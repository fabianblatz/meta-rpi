## conf/bblayers.conf.sample
```bitbake
# POKY_BBLAYERS_CONF_VERSION is increased each time build/conf/bblayers.conf
# changes incompatibly
POKY_BBLAYERS_CONF_VERSION = "2"

BBPATH = "${TOPDIR}"
BBFILES ?= ""

BBLAYERS ?= " \
  ##OEROOT##/meta \
  ##OEROOT##/meta-poky \
  ##OEROOT##/meta-yocto-bsp \
  ##OEROOT##/../openembedded/meta-oe \
  ##OEROOT##/../openembedded/meta-multimedia \
  ##OEROOT##/../openembedded/meta-networking \
  ##OEROOT##/../openembedded/meta-webserver \
  ##OEROOT##/../openembedded/meta-python \
  ##OEROOT##/../meta-qt5 \
  ##OEROOT##/../meta-raspberrypi \
  ##OEROOT##/../../meta-rpi\
  "
```

## conf/distro/rpi.conf
```bitbake
# Distro Layer configuration
# include and overwrite default poky distro

require conf/distro/poky.conf

# rpi distro parameters
DISTRO = "rpi"
DISTRO_NAME = "rpi-Linux"
# set to X.Y.Z for releases, X.Y-1.99 for development (after release), use last number for rc numbering
# e.g 0.3.99 = version 0.4-dev
#     0.4.0  = version 0.4.0 release candiate 1, if OK -> release it + set last to 99
#     0.4.1  = version 0.4.1 release candiate 2, if OK -> release it + set last to 99
#     if adding bugfixes, use/increase Z patch level number and keep minor.
#     if needing more than 99 release candiates + bugfixes, you're screwed anyway
DISTRO_VERSION = "0.0.1"
DISTRO_CODENAME = "rpi"
SDK_VENDOR = "-rpisdk"
SDK_VERSION="${DISTRO_VERSION}"
# Make sure this is a valid email address
MAINTAINER = "vielspeicherplatz6@gmail.com"

TARGET_VENDOR = "-rpi"

# defaults to timestamp, which messes up a lot of things.
IMAGE_VERSION_SUFFIX = ""

# Override these in poky based distros
rpi_DEFAULT_DISTRO_FEATURES = "usbhost xattr nfs alsa ipv6 wifi bluetooth bluez5 pulseaudio zeroconf"
# rpi_DEFAULT_DISTRO_FEATURES += "directfb"
rpi_DEFAULT_EXTRA_RDEPENDS = "packagegroup-core-boot"
rpi_DEFAULT_EXTRA_RRECOMMENDS = "kernel-module-af-packet"

ROOT_HOME = "/root"
MAIN_USER="${DISTRO}"

DISTRO_EXTRA_RDEPENDS += " ${rpi_DEFAULT_EXTRA_RDEPENDS}"
DISTRO_EXTRA_RRECOMMENDS += " ${rpi_DEFAULT_EXTRA_RRECOMMENDS}"

DISTRO_FEATURES ?= "${rpi_DEFAULT_DISTRO_FEATURES} ${DISTRO_FEATURES_LIBC} "

# build rpm  (alternatives: rpm, ipk, deb)
PACKAGE_CLASSES = "package_rpm"

# Use systemd as init manager
INIT_MANAGER = "systemd"

BUILD_REPRODUCIBLE_BINARIES = "1"
INHERIT += "reproducible_build"
```

## conf/layer.conf
```bitbake
# We have a conf and classes directory, add to BBPATH
BBPATH .= ":${LAYERDIR}"

# We have recipes-* directories, add to BBFILES
BBFILES += "${LAYERDIR}/recipes-*/*/*.bb \
	    ${LAYERDIR}/recipes-*/*/*.bbappend \
	    ${LAYERDIR}/recipes-*/*/*/*.bb \
            ${LAYERDIR}/recipes-*/*/*/*.bbappend"

BBFILE_COLLECTIONS += "meta-rpi"
BBFILE_PATTERN_meta-rpi = "^${LAYERDIR}/"
BBFILE_PRIORITY_meta-rpi = "8"


LAYERSERIES_COMPAT_meta-rpi = "zeus"

GOVERSION = "1.12%"
```
